## app/dts/bindings/behaviors/zmk,behavior-win-tab.yaml
```yaml
# Copyright (c) 2026 The ZMK Contributors
# SPDX-License-Identifier: MIT

description: Win Tab switcher hold behavior

compatible: "zmk,behavior-win-tab"

include: zero_param.yaml

properties:
  hold-positions:
    type: array
    required: true
```
