/*
 * Copyright (c) 2026 The ZMK Contributors
 *
 * SPDX-License-Identifier: MIT
 */

/ {
    behaviors {
        /omit-if-no-ref/ jiggle: behavior_mouse_jiggler {
            compatible = "zmk,behavior-mouse-jiggler";
            label = "MOUSE_JIGGLER";
            #binding-cells = <0>;
        };
    };
};
